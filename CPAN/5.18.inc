CPAN_PROJECTS := \
    MLDBM-2.05 \
    Mac-Errors-1.18 \
    Time-Epoch-0.02 \
    URI-1.60 \
    HTML-Tagset-3.20 \
    HTML-Parser-3.71 \
    HTTP-Date-6.02 \
    File-Listing-6.04 \
    LWP-MediaTypes-6.02 \
    Encode-Locale-1.03 \
    IO-HTML-1.00 \
    HTTP-Message-6.06 \
    HTML-Form-6.03 \
    HTTP-Cookies-6.01 \
    HTTP-Daemon-6.01 \
    HTTP-Negotiate-6.01 \
    Net-HTTP-6.06 \
    WWW-RobotRules-6.02 \
    libwww-perl-6.05 \
    IO-Socket-SSL-1.966 \
    LWP-Protocol-https-6.04 \
    Mac-Carbon-0.82 \
    Mac-Apps-Launch-1.93 \
    Mac-AppleEvents-Simple-1.18 \
    Mac-OSA-Simple-1.09 \
    Convert-BinHex-1.123 \
    Convert-UUlib-1.4 \
    IO-String-1.08 \
    Archive-Zip-1.37 \
    BerkeleyDB-0.54 \
    Test-Pod-1.48 \
    TimeDate-2.30 \
    MailTools-2.13 \
    IO-stringy-2.110 \
    Test-Tester-0.109 \
    Test-Deep-0.112 \
    MIME-tools-5.505 \
    Convert-TNEF-0.18 \
    Digest-SHA1-2.13 \
    Net-Server-2.007 \
    Unix-Syslog-1.1 \
    Socket6-0.25 \
    IO-Socket-INET6-2.72 \
    Digest-HMAC-1.03 \
    Net-IP-1.26 \
    Net-DNS-0.74 \
    Proc-Reliable-1.16 \
    Sub-Uplevel-0.24 \
    Test-Exception-0.32 \
    Carp-Clan-6.04 \
    Bit-Vector-7.3 \
    Date-Calc-6.3 \
    Convert-ASN1-0.26 \
    GSSAPI-0.28 \
    Net-SSLeay-1.58 \
    Authen-SASL-2.16 \
    XML-NamespaceSupport-1.11 \
    XML-SAX-Base-1.08 \
    XML-SAX-0.99 \
    perl-ldap-0.58 \
    DBI-1.631 \
    DBD-SQLite-1.40 \
    XML-LibXML-2.0110 \
    XML-Parser-2.41 \
    XML-Writer-0.623 \
    XML-XPath-1.13 \
    XML-SAX-Expat-0.51 \
    XML-Simple-2.20 \
    IO-Stty-0.03 \
    IO-Tty-1.10 \
    Expect-1.21 \
    Regexp-Common-2013031301 \
    Pod-Readme-0.11 \
    Class-Accessor-0.34 \
    File-Slurp-9999.19 \
    UNIVERSAL-require-0.15 \
    File-chdir-0.1008 \
    Net-CIDR-Lite-0.21 \
    Sys-Hostname-Long-1.4 \
    Mail-SPF-Query-1.999.1 \
    XML-LibXSLT-1.87 \
    Digest-CRC-0.18 \
    Error-0.17022 \
    NetAddr-IP-4.072 \
    Net-DNS-Resolver-Programmable-v0.003 \
    Mail-SPF-v2.9.0 \
    Crypt-OpenSSL-Random-0.04 \
    Crypt-OpenSSL-RSA-0.28 \
    Mail-DKIM-0.40 \
    Try-Tiny-0.19 \
    Sub-Name-0.05 \
    Scope-Guard-0.20 \
    Params-Util-1.07 \
    Sub-Install-0.927 \
    Data-OptList-0.109 \
    Sub-Exporter-0.987 \
    Sub-Exporter-Progressive-0.001011 \
    Devel-GlobalDestruction-0.12 \
    Algorithm-C3-0.08 \
    Class-C3-0.25 \
    MRO-Compat-0.12 \
    Task-Weaken-1.04 \
    Test-Fatal-0.013 \
    Test-Requires-0.07 \
    List-MoreUtils-0.33 \
    Dist-CheckConflicts-0.10 \
    Package-DeprecationManager-0.13 \
    Package-Stash-XS-0.28 \
    Package-Stash-0.36 \
    Capture-Tiny-0.23 \
    Test-Output-1.03 \
    Eval-Closure-0.11 \
    Module-Runtime-0.013 \
    Module-Implementation-0.07 \
    Class-Load-0.20 \
    Class-Load-XS-0.06 \
    Devel-StackTrace-1.31 \
    Moose-2.1202 \
    HTML-Tree-5.03 \
    Font-AFM-1.20 \
    HTML-Format-2.11 \
    Geography-Countries-2009041301 \
    IP-Country-2.28 \
    Encode-Detect-1.01 \
    Parse-RecDescent-1.967009 \
    Tree-DAG_Node-1.20 \
    Test-Warn-0.24 \
    Inline-0.53 \
    Inline-Python-0.43 \
    Inline-Struct-0.06 \
    Inline-Wrapper-0.05 \
    PAR-Dist-0.49 \
    PAR-1.007 \
    Getopt-ArgvFile-1.11 \
    Module-ScanDeps-1.13 \
    PAR-Packer-1.017 \
    Parse-Eyapp-1.182 \
    Data-Dumper-Concise-2.021 \
    Config-Any-0.24 \
    Class-Inspector-1.28 \
    Class-XSAccessor-1.19 \
    Class-Accessor-Grouped-0.10010 \
    Test-use-ok-0.11 \
    Context-Preserve-0.01 \
    Path-Class-0.33 \
    Clone-0.36 \
    Hash-Merge-0.200 \
    Params-Validate-1.08 \
    Getopt-Long-Descriptive-0.096 \
    SQL-Abstract-1.77 \
    Variable-Magic-0.53 \
    B-Hooks-EndOfScope-0.13 \
    namespace-clean-0.24 \
    Class-Accessor-Chained-0.01 \
    Data-Page-2.02 \
    Number-Compare-0.03 \
    Text-Glob-0.09 \
    File-Find-Rule-0.33 \
    Data-Compare-1.23 \
    Class-C3-Componentised-1.001000 \
    Module-Find-0.11 \
    ExtUtils-Config-0.007 \
    ExtUtils-Helpers-0.021 \
    ExtUtils-InstallPaths-0.010 \
    Module-Build-Tiny-0.034 \
    Class-Method-Modifiers-2.09 \
    Role-Tiny-1.003002 \
    Lexical-SealRequireHints-0.007 \
    bareword-filehandles-0.003 \
    indirect-0.31 \
    multidimensional-0.011 \
    strictures-1.005002 \
    Import-Into-1.002000 \
    Moo-1.004002 \
    DBIx-Class-0.08270 \
    autobox-2.82 \
    Perl6-Junction-1.60000 \
    syntax-0.004 \
    Syntax-Keyword-Junction-0.003007 \
    Moose-Autobox-0.15 \
    namespace-autoclean-0.15 \
    MooseX-StrictConstructor-0.19 \
    PadWalker-1.98 \
    Devel-Caller-2.06 \
    MooseX-Params-Validate-0.18 \
    MooseX-Role-Parameterized-1.02 \
    Data-Dump-1.22 \
    Test-Trap-v0.2.3 \
    MooseX-Getopt-0.59 \
    MooseX-Singleton-0.29 \
    MooseX-Types-0.41 \
    Params-Classify-0.013 \
    Class-Singleton-1.4 \
    DateTime-TimeZone-1.63 \
    DateTime-Locale-0.45 \
    Math-Round-0.06 \
    DateTime-1.06 \
    MooseX-Types-DateTime-0.10 \
    Class-Tiny-0.014 \
    Devel-PartialDump-0.17 \
    MooseX-Types-Structured-0.30 \
    aliased-0.31 \
    File-Remove-1.52 \
    Test-Object-0.07 \
    Hook-LexWrap-0.24 \
    Test-SubCalls-1.09 \
    PPI-1.215 \
    MooseX-Traits-0.12 \
    Algorithm-Diff-1.1902 \
    Text-Diff-1.41 \
    Test-Differences-0.61 \
    Parse-Method-Signatures-1.003016 \
    MooseX-TransactionalMethods-0.008 \
    CPAN-Meta-Check-0.008 \
    Test-CheckDeps-0.010 \
    MooseX-LazyRequire-0.10 \
    ExtUtils-Depends-0.306 \
    B-Hooks-OP-Check-0.19 \
    Devel-Declare-0.006015 \
    MooseX-Meta-TypeConstraint-ForceCoercion-0.01 \
    MooseX-AuthorizedMethods-0.006 \
    MooseX-Method-Signatures-0.47 \
    MooseX-Declare-0.38 \
    MooseX-ClassAttribute-0.27 \
    MooseX-NonMoose-0.24 \
    String-RewritePrefix-0.007 \
    MooseX-Storage-0.45

SVK_PROJECTS := \
    Algorithm-Annotate-0.10 \
    YAML-Syck-1.27 \
    Data-Hierarchy-0.34 \
    Internals-1.1 \
    PerlIO-via-dynamic-0.14 \
    PerlIO-via-symlink-0.05 \
    IO-Digest-0.11 \
    PerlIO-eol-0.14 \
    Class-Autouse-2.01 \
    App-CLI-0.313 \
    Class-Data-Inheritable-0.08 \
    TermReadKey-2.31 \
    Locale-Maketext-Lexicon-0.99 \
    IPC-Run3-0.046 \
    Probe-Perl-0.03 \
    Test-Script-1.07 \
    File-Which-1.09 \
    IO-Pager-0.31 \
    FreezeThaw-0.5001 \
    Time-Progress-1.8 \
    Compress-Bzip2-2.17 \
    PerlIO-via-Bzip2-0.02 \
    PerlIO-gzip-0.18

PROJECTS = $(CPAN_PROJECTS) $(SVK_PROJECTS)
