CPAN_PROJECTS = \
    MLDBM-2.04 \
    Mac-Errors-1.14 \
    Time-Epoch-0.02 \
    URI-1.59 \
    HTML-Tagset-3.20 \
    HTML-Parser-3.69 \
    HTTP-Date-6.00 \
    File-Listing-6.03 \
    LWP-MediaTypes-6.01 \
    Encode-Locale-1.02 \
    HTTP-Message-6.02 \
    HTML-Form-6.00 \
    HTTP-Cookies-6.00 \
    HTTP-Daemon-6.00 \
    HTTP-Negotiate-6.00 \
    Net-HTTP-6.01 \
    WWW-RobotRules-6.01 \
    libwww-perl-6.03 \
    LWP-Protocol-https-6.02 \
    Mac-Carbon-0.82 \
    Mac-Apps-Launch-1.93 \
    Mac-AppleEvents-Simple-1.18 \
    Mac-OSA-Simple-1.09 \
    Convert-BinHex-1.119 \
    Convert-UUlib-1.4 \
    IO-String-1.08 \
    Archive-Zip-1.30 \
    BerkeleyDB-0.49 \
    Test-Pod-1.45 \
    TimeDate-1.20 \
    MailTools-2.08 \
    IO-stringy-2.110 \
    Test-Tester-0.107 \
    Test-Deep-0.108 \
    MIME-tools-5.502 \
    Convert-TNEF-0.17 \
    Digest-SHA1-2.13 \
    Net-Server-0.99 \
    Unix-Syslog-1.1 \
    Socket6-0.23 \
    IO-Socket-INET6-2.67 \
    Digest-HMAC-1.03 \
    Net-IP-1.25 \
    Net-DNS-0.66 \
    Proc-Reliable-1.16 \
    Sub-Uplevel-0.22 \
    Test-Exception-0.31 \
    Carp-Clan-6.04 \
    Bit-Vector-7.1 \
    Date-Calc-6.3 \
    Convert-ASN1-0.22 \
    GSSAPI-0.28 \
    Net-SSLeay-1.42 \
    IO-Socket-SSL-1.49 \
    Authen-SASL-2.15 \
    XML-NamespaceSupport-1.11 \
    XML-SAX-Base-1.08 \
    XML-SAX-0.99 \
    perl-ldap-0.43 \
    DBI-1.616 \
    DBD-SQLite-1.33 \
    XML-LibXML-1.88 \
    XML-Parser-2.41 \
    XML-Writer-0.612 \
    XML-XPath-1.13 \
    XML-Simple-2.18 \
    IO-Stty-0.03 \
    IO-Tty-1.10 \
    Expect-1.21 \
    Regexp-Common-2011041701 \
    Pod-Readme-0.11 \
    Class-Accessor-0.34 \
    File-Slurp-9999.19 \
    UNIVERSAL-require-0.13 \
    File-chdir-0.1004 \
    Net-CIDR-Lite-0.21 \
    Sys-Hostname-Long-1.4 \
    Mail-SPF-Query-1.999.1 \
    XML-LibXSLT-1.75 \
    Digest-CRC-0.17 \
    Error-0.17016 \
    NetAddr-IP-4.055 \
    Net-DNS-Resolver-Programmable-v0.003 \
    Mail-SPF-v2.007 \
    Crypt-OpenSSL-Random-0.04 \
    Crypt-OpenSSL-RSA-0.28 \
    Mail-DKIM-0.39 \
    Try-Tiny-0.11 \
    Sub-Name-0.05 \
    Scope-Guard-0.20 \
    Params-Util-1.04 \
    Sub-Install-0.925 \
    Data-OptList-0.107 \
    Sub-Exporter-0.982 \
    Devel-GlobalDestruction-0.04 \
    Algorithm-C3-0.08 \
    Class-C3-0.23 \
    MRO-Compat-0.11 \
    Task-Weaken-1.04 \
    Test-Fatal-0.006 \
    Test-Requires-0.06 \
    List-MoreUtils-0.33 \
    Dist-CheckConflicts-0.02 \
    Package-DeprecationManager-0.11 \
    Package-Stash-XS-0.25 \
    Package-Stash-0.33 \
    Test-Output-1.01 \
    Eval-Closure-0.06 \
    Moose-2.0205 \
    HTML-Tree-4.2 \
    Font-AFM-1.20 \
    HTML-Format-2.10 \
    Geography-Countries-2009041301 \
    IP-Country-2.27 \
    Encode-Detect-1.01 \
    Parse-RecDescent-1.965001 \
    Tree-DAG_Node-1.06 \
    Test-Warn-0.23 \
    Inline-0.48 \
    Inline-Python-0.40 \
    Inline-Struct-0.06 \
    Inline-Wrapper-0.05 \
    PAR-Dist-0.47 \
    PAR-1.002 \
    Getopt-ArgvFile-1.11 \
    Module-ScanDeps-1.05 \
    PAR-Packer-1.010 \
    Parse-Eyapp-1.181 \
    Data-Dumper-Concise-2.020 \
    Module-Pluggable-3.9 \
    Config-Any-0.23 \
    Class-Inspector-1.25 \
    Class-XSAccessor-1.12 \
    Class-Accessor-Grouped-0.10003 \
    Test-use-ok-0.02 \
    Context-Preserve-0.01 \
    Path-Class-0.24 \
    Clone-0.31 \
    Hash-Merge-0.12 \
    Params-Validate-1.00 \
    Getopt-Long-Descriptive-0.090 \
    SQL-Abstract-1.72 \
    Variable-Magic-0.47 \
    B-Hooks-EndOfScope-0.09 \
    namespace-clean-0.21 \
    Class-Accessor-Chained-0.01 \
    Data-Page-2.02 \
    Number-Compare-0.03 \
    Text-Glob-0.09 \
    File-Find-Rule-0.33 \
    Data-Compare-1.22 \
    Class-C3-Componentised-1.001000 \
    Module-Find-0.10 \
    DBIx-Class-0.08195 \
    autobox-2.75 \
    Perl6-Junction-1.40000 \
    Moose-Autobox-0.11 \
    namespace-autoclean-0.13 \
    MooseX-StrictConstructor-0.16 \
    PadWalker-1.92 \
    Devel-Caller-2.05 \
    MooseX-Params-Validate-0.16 \
    MooseX-Role-Parameterized-0.27 \
    MooseX-Getopt-0.37 \
    MooseX-Singleton-0.27 \
    MooseX-Types-0.30 \
    Params-Classify-0.013 \
    Module-Runtime-0.011 \
    Class-Load-0.12 \
    Class-Singleton-1.4 \
    DateTime-TimeZone-1.41 \
    DateTime-Locale-0.45 \
    Math-Round-0.06 \
    DateTime-0.70 \
    MooseX-Types-DateTime-0.05 \
    Devel-PartialDump-0.15 \
    MooseX-Types-Structured-0.28 \
    aliased-0.30 \
    File-Remove-1.51 \
    Test-Object-0.07 \
    Hook-LexWrap-0.24 \
    Test-SubCalls-1.09 \
    PPI-1.215 \
    MooseX-Traits-0.11 \
    Algorithm-Diff-1.1902 \
    Text-Diff-1.41 \
    Test-Differences-0.61 \
    Parse-Method-Signatures-1.003014 \
    MooseX-TransactionalMethods-0.008 \
    MooseX-LazyRequire-0.07 \
    ExtUtils-Depends-0.304 \
    B-Hooks-OP-Check-0.19 \
    Devel-Declare-0.006007 \
    MooseX-Meta-TypeConstraint-ForceCoercion-0.01 \
    MooseX-AuthorizedMethods-0.006 \
    MooseX-Method-Signatures-0.37 \
    MooseX-Declare-0.35 \
    MooseX-ClassAttribute-0.26 \
    MooseX-NonMoose-0.22 \
    String-RewritePrefix-0.006 \
    MooseX-Storage-0.30

SVK_PROJECTS = \
    Algorithm-Diff-1.1902 \
    Algorithm-Annotate-0.10 \
    YAML-Syck-1.17 \
    Data-Hierarchy-0.34 \
    Internals-1.1 \
    PerlIO-via-dynamic-0.13 \
    PerlIO-via-symlink-0.05 \
    IO-Digest-0.10 \
    PerlIO-eol-0.14 \
    Class-Autouse-2.00 \
    App-CLI-0.313 \
    Class-Data-Inheritable-0.08 \
    Path-Class-0.24 \
    TermReadKey-2.30 \
    Locale-Maketext-Lexicon-0.91 \
    IO-Pager-0.06 \
    FreezeThaw-0.5001 \
    Time-Progress-1.7 \
    Compress-Bzip2-2.09 \
    PerlIO-via-Bzip2-0.02 \
    PerlIO-gzip-0.18

PROJECTS = $(CPAN_PROJECTS) $(SVK_PROJECTS)
