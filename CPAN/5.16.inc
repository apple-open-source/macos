CPAN_PROJECTS := \
    MLDBM-2.04 \
    Mac-Errors-1.16 \
    Time-Epoch-0.02 \
    URI-1.60 \
    HTML-Tagset-3.20 \
    HTML-Parser-3.69 \
    HTTP-Date-6.02 \
    File-Listing-6.04 \
    LWP-MediaTypes-6.02 \
    Encode-Locale-1.03 \
    IO-HTML-0.04 \
    HTTP-Message-6.06 \
    HTML-Form-6.03 \
    HTTP-Cookies-6.01 \
    HTTP-Daemon-6.01 \
    HTTP-Negotiate-6.01 \
    Net-HTTP-6.03 \
    WWW-RobotRules-6.02 \
    libwww-perl-6.04 \
    IO-Socket-SSL-1.77 \
    LWP-Protocol-https-6.03 \
    Mac-Carbon-0.82 \
    Mac-Apps-Launch-1.93 \
    Mac-AppleEvents-Simple-1.18 \
    Mac-OSA-Simple-1.09 \
    Convert-BinHex-1.119 \
    Convert-UUlib-1.4 \
    IO-String-1.08 \
    Archive-Zip-1.30 \
    BerkeleyDB-0.51 \
    Test-Pod-1.45 \
    TimeDate-1.20 \
    MailTools-2.11 \
    IO-stringy-2.110 \
    Test-Tester-0.108 \
    Test-Deep-0.110 \
    MIME-tools-5.503 \
    Convert-TNEF-0.18 \
    Digest-SHA1-2.13 \
    Net-Server-2.006 \
    Unix-Syslog-1.1 \
    Socket6-0.23 \
    IO-Socket-INET6-2.69 \
    Digest-HMAC-1.03 \
    Net-IP-1.25 \
    Net-DNS-0.68 \
    Proc-Reliable-1.16 \
    Sub-Uplevel-0.24 \
    Test-Exception-0.31 \
    Carp-Clan-6.04 \
    Bit-Vector-7.2 \
    Date-Calc-6.3 \
    Convert-ASN1-0.26 \
    GSSAPI-0.28 \
    Net-SSLeay-1.49 \
    Authen-SASL-2.16 \
    XML-NamespaceSupport-1.11 \
    XML-SAX-Base-1.08 \
    XML-SAX-0.99 \
    perl-ldap-0.49 \
    DBI-1.622 \
    DBD-SQLite-1.37 \
    XML-LibXML-2.0008 \
    XML-Parser-2.41 \
    XML-Writer-0.615 \
    XML-XPath-1.13 \
    XML-SAX-Expat-0.40 \
    XML-Simple-2.20 \
    IO-Stty-0.03 \
    IO-Tty-1.10 \
    Expect-1.21 \
    Regexp-Common-2011121001 \
    Pod-Readme-0.11 \
    Class-Accessor-0.34 \
    File-Slurp-9999.19 \
    UNIVERSAL-require-0.13 \
    File-chdir-0.1007 \
    Net-CIDR-Lite-0.21 \
    Sys-Hostname-Long-1.4 \
    Mail-SPF-Query-1.999.1 \
    XML-LibXSLT-1.78 \
    Digest-CRC-0.18 \
    Error-0.17018 \
    NetAddr-IP-4.065 \
    Net-DNS-Resolver-Programmable-v0.003 \
    Mail-SPF-v2.8.0 \
    Crypt-OpenSSL-Random-0.04 \
    Crypt-OpenSSL-RSA-0.28 \
    Mail-DKIM-0.39 \
    Try-Tiny-0.11 \
    Sub-Name-0.05 \
    Scope-Guard-0.20 \
    Params-Util-1.07 \
    Sub-Install-0.926 \
    Data-OptList-0.107 \
    Sub-Exporter-0.984 \
    Sub-Exporter-Progressive-0.001006 \
    Devel-GlobalDestruction-0.09 \
    Algorithm-C3-0.08 \
    Class-C3-0.24 \
    MRO-Compat-0.11 \
    Task-Weaken-1.04 \
    Test-Fatal-0.010 \
    Test-Requires-0.06 \
    List-MoreUtils-0.33 \
    Dist-CheckConflicts-0.02 \
    Package-DeprecationManager-0.13 \
    Package-Stash-XS-0.25 \
    Package-Stash-0.33 \
    Test-Output-1.01 \
    Eval-Closure-0.08 \
    Module-Runtime-0.013 \
    Module-Implementation-0.06 \
    Class-Load-0.20 \
    Class-Load-XS-0.06 \
    Moose-2.0604 \
    HTML-Tree-5.03 \
    Font-AFM-1.20 \
    HTML-Format-2.10 \
    Geography-Countries-2009041301 \
    IP-Country-2.27 \
    Encode-Detect-1.01 \
    Parse-RecDescent-1.967009 \
    Tree-DAG_Node-1.06 \
    Test-Warn-0.24 \
    Inline-0.51 \
    Inline-Python-0.40 \
    Inline-Struct-0.06 \
    Inline-Wrapper-0.05 \
    PAR-Dist-0.49 \
    PAR-1.007 \
    Getopt-ArgvFile-1.11 \
    Module-ScanDeps-1.10 \
    PAR-Packer-1.013 \
    Parse-Eyapp-1.182 \
    Data-Dumper-Concise-2.020 \
    Config-Any-0.23 \
    Class-Inspector-1.28 \
    Class-XSAccessor-1.14 \
    Class-Accessor-Grouped-0.10006 \
    Test-use-ok-0.11 \
    Context-Preserve-0.01 \
    Path-Class-0.26 \
    Clone-0.31 \
    Hash-Merge-0.12 \
    Params-Validate-1.06 \
    Getopt-Long-Descriptive-0.092 \
    SQL-Abstract-1.73 \
    Variable-Magic-0.51 \
    B-Hooks-EndOfScope-0.11 \
    namespace-clean-0.23 \
    Class-Accessor-Chained-0.01 \
    Data-Page-2.02 \
    Number-Compare-0.03 \
    Text-Glob-0.09 \
    File-Find-Rule-0.33 \
    Data-Compare-1.22 \
    Class-C3-Componentised-1.001000 \
    Module-Find-0.11 \
    Class-Method-Modifiers-1.10 \
    Role-Tiny-1.002001 \
    strictures-1.004002 \
    Moo-1.000005 \
    DBIx-Class-0.08203 \
    autobox-2.75 \
    Perl6-Junction-1.50000 \
    syntax-0.004 \
    Syntax-Keyword-Junction-0.003001 \
    Moose-Autobox-0.13 \
    namespace-autoclean-0.13 \
    MooseX-StrictConstructor-0.19 \
    PadWalker-1.96 \
    Devel-Caller-2.05 \
    MooseX-Params-Validate-0.16 \
    MooseX-Role-Parameterized-1.00 \
    Data-Dump-1.21 \
    Test-Trap-v0.2.2 \
    MooseX-Getopt-0.47 \
    MooseX-Singleton-0.29 \
    MooseX-Types-0.35 \
    Params-Classify-0.013 \
    Class-Singleton-1.4 \
    DateTime-TimeZone-1.51 \
    DateTime-Locale-0.45 \
    Math-Round-0.06 \
    DateTime-0.77 \
    MooseX-Types-DateTime-0.07 \
    Devel-PartialDump-0.15 \
    MooseX-Types-Structured-0.28 \
    aliased-0.30 \
    File-Remove-1.52 \
    Test-Object-0.07 \
    Hook-LexWrap-0.24 \
    Test-SubCalls-1.09 \
    PPI-1.215 \
    MooseX-Traits-0.11 \
    Algorithm-Diff-1.1902 \
    Text-Diff-1.41 \
    Test-Differences-0.61 \
    Parse-Method-Signatures-1.003014 \
    MooseX-TransactionalMethods-0.008 \
    CPAN-Meta-Check-0.004 \
    Test-CheckDeps-0.002 \
    MooseX-LazyRequire-0.08 \
    ExtUtils-Depends-0.304 \
    B-Hooks-OP-Check-0.19 \
    Devel-Declare-0.006011 \
    MooseX-Meta-TypeConstraint-ForceCoercion-0.01 \
    MooseX-AuthorizedMethods-0.006 \
    MooseX-Method-Signatures-0.43 \
    MooseX-Declare-0.35 \
    MooseX-ClassAttribute-0.26 \
    MooseX-NonMoose-0.22 \
    String-RewritePrefix-0.006 \
    MooseX-Storage-0.31

SVK_PROJECTS := \
    Algorithm-Annotate-0.10 \
    YAML-Syck-1.21 \
    Data-Hierarchy-0.34 \
    Internals-1.1 \
    PerlIO-via-dynamic-0.13 \
    PerlIO-via-symlink-0.05 \
    IO-Digest-0.10 \
    PerlIO-eol-0.14 \
    Class-Autouse-2.01 \
    App-CLI-0.313 \
    Class-Data-Inheritable-0.08 \
    TermReadKey-2.30 \
    Locale-Maketext-Lexicon-0.91 \
    IPC-Run3-0.045 \
    Probe-Perl-0.01 \
    Test-Script-1.07 \
    File-Which-1.09 \
    IO-Pager-0.30 \
    FreezeThaw-0.5001 \
    Time-Progress-1.7 \
    Compress-Bzip2-2.09 \
    PerlIO-via-Bzip2-0.02 \
    PerlIO-gzip-0.18

PROJECTS = $(CPAN_PROJECTS) $(SVK_PROJECTS)
