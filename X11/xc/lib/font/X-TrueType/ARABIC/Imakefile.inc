XCOMM $XFree86: xc/lib/font/X-TrueType/ARABIC/Imakefile.inc,v 1.2 2003/07/27 02:01:20 dawes Exp $

#define ModuleName ARABIC
MODULENAME = ModuleName
MODULESRCDIR= $(XTTSOURCEDIR)/$(MODULENAME)

SRCS = main.c MULEARABICtoUCS2.c CP1256toUCS2.c XATERMtoUCS2.c \
       ISIRI3342toUCS2.c IRANSYSTEMtoUCS2.c URDUNAQSHtoUCS2.c
OBJS = main.o MULEARABICtoUCS2.o CP1256toUCS2.o XATERMtoUCS2.o \
       ISIRI3342toUCS2.o IRANSYSTEMtoUCS2.o URDUNAQSHtoUCS2.o

LinkSourceFile(main.c,$(MODULESRCDIR))
LinkSourceFile(MULEARABICtoUCS2.c,$(MODULESRCDIR))
LinkSourceFile(CP1256toUCS2.c,$(MODULESRCDIR))
LinkSourceFile(XATERMtoUCS2.c,$(MODULESRCDIR))
LinkSourceFile(ISIRI3342toUCS2.c,$(MODULESRCDIR))
LinkSourceFile(IRANSYSTEMtoUCS2.c,$(MODULESRCDIR))
LinkSourceFile(URDUNAQSHtoUCS2.c,$(MODULESRCDIR))
