/*------------------------------------------------------------------------
|   WARNING! This is file automatically generated by GenCompactCodings !  
|   WARNING!         Do not edit!                                         
|                                                                         
|   Unicode(UTF) ---> 8bit code conversion tables                         
|                                                                         
\-----------------------------------------------------------------------*/
static TEncodingRule TDOM_UnicodeToASCII [] = {
    { ENC_IDENTITY, 1, 126, "" }, 
    { ENC_END, 0, 0, NULL } 
};

static TEncodingRule TDOM_UnicodeToCP1250 [] = {
    { ENC_IDENTITY, 1, 129, "" }, 
    { ENC_MAP, 131, 153, 
        "\203\077\077\077\210\077\077\077\077\077\077\077\220\077"
        "\077\077\077\077\077\077\230\077\077\077\077\077\077\077"
        "\240\077\077\077\244\077\246\247\250\251\077\253\077\255"
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        "\303\343\245\271\306\346\077\077\077\077\310\350\317\357"
        "\320\360\077\077\077\077\077\077\312\352\314\354" },
    { ENC_MAP, 313, 70, 
        "\305\345\077\077\274\276\077\077\243\263\321\361\077\077"
        "\322\362\077\077\077\077\077\077\077\325\365\077\077\300"
        "\340\077\077\330\370\214\234\077\077\252\272\212\232\336"
        "\376\215\235\077\077\077\077\077\077\077\077\331\371\333"
        "\373\077\077\077\077\077\077\077\217\237\257\277\216\236"
    },
    { ENC_MAP, 711, 23, 
        "\241\077\077\077\077\077\077\077\077\077\077\077\077\077"
        "\077\077\077\242\377\077\262\077\275" },
    { ENC_MAP, 8211, 40, 
        "\226\227\077\077\077\221\222\202\077\223\224\204\077\206"
        "\207\225\077\077\077\205\077\077\077\077\077\077\077\077"
        "\077\211\077\077\077\077\077\077\077\077\213\233" },
    { ENC_MAP, 8482, 1, 
        "\231" },
    { ENC_END, 0, 0, NULL } 
};

static TEncodingRule TDOM_UnicodeToCP1251 [] = {
    { ENC_IDENTITY, 1, 127, "" }, 
    { ENC_MAP, 136, 52, 
        "\210\077\077\077\077\077\077\077\077\077\077\077\077\077"
        "\077\230\077\077\077\077\077\077\077\240\077\077\077\244"
        "\077\246\247\077\251\077\253\254\255\256\077\260\261\077"
        "\077\077\265\266\267\077\077\077\273" },
    { ENC_MAP, 1025, 95, 
        "\250\200\201\252\275\262\257\243\212\214\216\215\077\241"
        "\217\300\301\302\303\304\305\306\307\310\311\312\313\314"
        "\315\316\317\320\321\322\323\324\325\326\327\330\331\332"
        "\333\334\335\336\337\340\341\342\343\344\345\346\347\350"
        "\351\352\353\354\355\356\357\360\361\362\363\364\365\366"
        "\367\370\371\372\373\374\375\376\377\077\270\220\203\272"
        "\276\263\277\274\232\234\236\235\077\242\237" },
    { ENC_MAP, 1168, 2, 
        "\245\264" },
    { ENC_MAP, 8211, 40, 
        "\226\227\077\077\077\221\222\202\077\223\224\204\077\206"
        "\207\225\077\077\077\205\077\077\077\077\077\077\077\077"
        "\077\211\077\077\077\077\077\077\077\077\213\233" },
    { ENC_MAP, 8470, 13, 
        "\271\077\077\077\077\077\077\077\077\077\077\077\231" },
    { ENC_END, 0, 0, NULL } 
};

static TEncodingRule TDOM_UnicodeToCP1252 [] = {
    { ENC_IDENTITY, 1, 129, "" }, 
    { ENC_MAP, 141, 18, 
        "\215\216\217\220\077\077\077\077\077\077\077\077\235\236"
    },
    { ENC_IDENTITY, 160, 96, "" }, 
    { ENC_MAP, 338, 16, 
        "\214\234\077\077\077\077\077\077\077\077\077\077\077\077"
        "\212\232" },
    { ENC_MAP, 376, 1, 
        "\237" },
    { ENC_MAP, 402, 1, 
        "\203" },
    { ENC_MAP, 710, 1, 
        "\210" },
    { ENC_MAP, 732, 1, 
        "\230" },
    { ENC_MAP, 8211, 40, 
        "\226\227\077\077\077\221\222\202\077\223\224\204\077\206"
        "\207\225\077\077\077\205\077\077\077\077\077\077\077\077"
        "\077\211\077\077\077\077\077\077\077\077\213\233" },
    { ENC_MAP, 8482, 1, 
        "\231" },
    { ENC_END, 0, 0, NULL } 
};

static TEncodingRule TDOM_UnicodeToCP1253 [] = {
    { ENC_IDENTITY, 1, 129, "" }, 
    { ENC_MAP, 136, 54, 
        "\210\212\077\214\215\216\217\220\077\077\077\077\077\077"
        "\077\230\077\232\077\234\235\236\237\240\077\077\243\244"
        "\245\246\247\250\251\077\253\254\255\256\077\260\261\262"
        "\263\077\265\266\267\077\077\077\273\077\275" },
    { ENC_MAP, 402, 1, 
        "\203" },
    { ENC_MAP, 900, 75, 
        "\264\241\242\077\270\271\272\077\274\077\276\277\300\301"
        "\302\303\304\305\306\307\310\311\312\313\314\315\316\317"
        "\320\321\077\323\324\325\326\327\330\331\332\333\334\335"
        "\336\337\340\341\342\343\344\345\346\347\350\351\352\353"
        "\354\355\356\357\360\361\362\363\364\365\366\367\370\371"
        "\372\373\374\375\376" },
    { ENC_MAP, 8211, 40, 
        "\226\227\257\077\077\221\222\202\077\223\224\204\077\206"
        "\207\225\077\077\077\205\077\077\077\077\077\077\077\077"
        "\077\211\077\077\077\077\077\077\077\077\213\233" },
    { ENC_MAP, 8482, 1, 
        "\231" },
    { ENC_END, 0, 0, NULL } 
};

static TEncodingRule TDOM_UnicodeToCP1254 [] = {
    { ENC_IDENTITY, 1, 129, "" }, 
    { ENC_MAP, 141, 115, 
        "\215\216\217\220\077\077\077\077\077\077\077\077\235\236"
        "\077\240\241\242\243\244\245\246\247\250\251\252\253\254"
        "\255\256\257\260\261\262\263\264\265\266\267\270\271\272"
        "\273\274\275\276\277\300\301\302\303\304\305\306\307\310"
        "\311\312\313\314\315\316\317\077\321\322\323\324\325\326"
        "\327\330\331\332\333\334\077\077\337\340\341\342\343\344"
        "\345\346\347\350\351\352\353\354\355\356\357\077\361\362"
        "\363\364\365\366\367\370\371\372\373\374\077\077\377" },
    { ENC_MAP, 286, 20, 
        "\320\360\077\077\077\077\077\077\077\077\077\077\077\077"
        "\077\077\077\077\335\375" },
    { ENC_MAP, 338, 16, 
        "\214\234\077\077\077\077\077\077\077\077\077\077\336\376"
        "\212\232" },
    { ENC_MAP, 376, 1, 
        "\237" },
    { ENC_MAP, 402, 1, 
        "\203" },
    { ENC_MAP, 710, 1, 
        "\210" },
    { ENC_MAP, 732, 1, 
        "\230" },
    { ENC_MAP, 8211, 40, 
        "\226\227\077\077\077\221\222\202\077\223\224\204\077\206"
        "\207\225\077\077\077\205\077\077\077\077\077\077\077\077"
        "\077\211\077\077\077\077\077\077\077\077\213\233" },
    { ENC_MAP, 8482, 1, 
        "\231" },
    { ENC_END, 0, 0, NULL } 
};

static TEncodingRule TDOM_UnicodeToCP1255 [] = {
    { ENC_IDENTITY, 1, 129, "" }, 
    { ENC_MAP, 138, 53, 
        "\212\214\215\216\217\220\077\077\077\077\077\077\077\077"
        "\077\232\077\234\235\236\237\240\077\242\243\077\245\246"
        "\247\250\251\077\253\254\255\256\257\260\261\262\263\264"
        "\265\266\267\077\271\077\273\274\275\276" },
    { ENC_MAP, 402, 1, 
        "\203" },
    { ENC_MAP, 710, 1, 
        "\210" },
    { ENC_MAP, 732, 1, 
        "\230" },
    { ENC_MAP, 1456, 67, 
        "\300\301\302\303\304\305\306\307\310\311\312\313\314\315"
        "\316\317\320\321\322\323\077\077\077\077\077\077\077\077"
        "\077\077\077\077\340\341\342\343\344\345\346\347\350\351"
        "\352\353\354\355\356\357\360\361\362\363\364\365\366\367"
        "\370\371\372\077\077\077\077\077\324\325\326" },
    { ENC_MAP, 8206, 45, 
        "\375\376\077\077\077\226\227\077\077\077\221\222\202\077"
        "\223\224\204\077\206\207\225\077\077\077\205\077\077\077"
        "\077\077\077\077\077\077\211\077\077\077\077\077\077\077"
        "\077\213\233" },
    { ENC_MAP, 8362, 1, 
        "\244" },
    { ENC_MAP, 8482, 1, 
        "\231" },
    { ENC_END, 0, 0, NULL } 
};

static TEncodingRule TDOM_UnicodeToCP1256 [] = {
    { ENC_IDENTITY, 1, 128, "" }, 
    { ENC_MAP, 138, 53, 
        "\212\077\077\077\217\077\077\077\077\077\077\077\077\230"
        "\077\232\077\077\077\077\237\240\077\242\243\244\245\246"
        "\247\250\251\077\253\254\255\256\257\260\261\262\263\264"
        "\265\266\267\270\271\077\273\274\275\276" },
    { ENC_MAP, 215, 38, 
        "\327\077\077\077\077\077\077\077\340\077\342\077\077\077"
        "\077\347\350\351\352\353\077\077\356\357\077\077\077\077"
        "\364\077\077\367\077\371\077\373\374" },
    { ENC_MAP, 338, 2, 
        "\214\234" },
    { ENC_MAP, 402, 1, 
        "\203" },
    { ENC_MAP, 710, 1, 
        "\210" },
    { ENC_MAP, 1548, 71, 
        "\241\077\077\077\077\077\077\077\077\077\077\077\077\077"
        "\077\272\077\077\077\277\077\301\302\303\304\305\306\307"
        "\310\311\312\313\314\315\316\317\320\321\322\323\324\325"
        "\326\330\331\332\333\077\077\077\077\077\334\335\336\337"
        "\341\343\344\345\346\354\355\360\361\362\363\365\366\370"
        "\372" },
    { ENC_MAP, 1662, 27, 
        "\201\077\077\077\077\077\077\077\215\077\077\077\077\077"
        "\077\077\077\077\077\077\077\077\077\077\077\077\216" },
    { ENC_MAP, 1711, 1, 
        "\220" },
    { ENC_MAP, 8204, 47, 
        "\235\236\375\376\077\077\077\226\227\077\077\077\221\222"
        "\202\077\223\224\204\077\206\207\225\077\077\077\205\077"
        "\077\077\077\077\077\077\077\077\211\077\077\077\077\077"
        "\077\077\077\213\233" },
    { ENC_MAP, 8482, 1, 
        "\231" },
    { ENC_END, 0, 0, NULL } 
};

static TEncodingRule TDOM_UnicodeToCP437 [] = {
    { ENC_IDENTITY, 1, 127, "" }, 
    { ENC_MAP, 160, 96, 
        "\377\255\233\234\077\235\077\077\077\077\246\256\252\077"
        "\077\077\370\361\375\077\077\346\077\372\077\077\247\257"
        "\254\253\077\250\077\077\077\077\216\217\222\200\077\220"
        "\077\077\077\077\077\077\077\245\077\077\077\077\231\077"
        "\077\077\077\077\232\077\077\341\205\240\203\077\204\206"
        "\221\207\212\202\210\211\215\241\214\213\077\244\225\242"
        "\223\077\224\366\077\227\243\226\201\077\077\230" },
    { ENC_MAP, 402, 1, 
        "\237" },
    { ENC_MAP, 915, 52, 
        "\342\077\077\077\077\351\077\077\077\077\077\077\077\077"
        "\077\077\344\077\077\350\077\077\352\077\077\077\077\077"
        "\077\077\340\077\077\353\356\077\077\077\077\077\077\077"
        "\077\077\077\343\077\077\345\347\077\355" },
    { ENC_MAP, 8319, 1, 
        "\374" },
    { ENC_MAP, 8359, 1, 
        "\236" },
    { ENC_MAP, 8729, 17, 
        "\371\373\077\077\077\354\077\077\077\077\077\077\077\077"
        "\077\077\357" },
    { ENC_MAP, 8776, 1, 
        "\367" },
    { ENC_MAP, 8801, 5, 
        "\360\077\077\363\362" },
    { ENC_MAP, 8976, 18, 
        "\251\077\077\077\077\077\077\077\077\077\077\077\077\077"
        "\077\077\364\365" },
    { ENC_MAP, 9472, 161, 
        "\304\077\263\077\077\077\077\077\077\077\077\077\332\077"
        "\077\077\277\077\077\077\300\077\077\077\331\077\077\077"
        "\303\077\077\077\077\077\077\077\264\077\077\077\077\077"
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        "\335\077\077\077\336\260\261\262\077\077\077\077\077\077"
        "\077\077\077\077\077\077\376" },
    { ENC_END, 0, 0, NULL } 
};

static TEncodingRule TDOM_UnicodeToCP850 [] = {
    { ENC_IDENTITY, 1, 127, "" }, 
    { ENC_MAP, 160, 96, 
        "\377\255\275\234\317\276\335\365\371\270\246\256\252\360"
        "\251\356\370\361\375\374\357\346\364\372\367\373\247\257"
        "\254\253\363\250\267\265\266\307\216\217\222\200\324\220"
        "\322\323\336\326\327\330\321\245\343\340\342\345\231\236"
        "\235\353\351\352\232\355\350\341\205\240\203\306\204\206"
        "\221\207\212\202\210\211\215\241\214\213\320\244\225\242"
        "\223\344\224\366\233\227\243\226\201\354\347\230" },
    { ENC_MAP, 305, 1, 
        "\325" },
    { ENC_MAP, 402, 1, 
        "\237" },
    { ENC_MAP, 8215, 1, 
        "\362" },
    { ENC_MAP, 9472, 161, 
        "\304\077\263\077\077\077\077\077\077\077\077\077\332\077"
        "\077\077\277\077\077\077\300\077\077\077\331\077\077\077"
        "\303\077\077\077\077\077\077\077\264\077\077\077\077\077"
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        "\077\077\077\077\077\260\261\262\077\077\077\077\077\077"
        "\077\077\077\077\077\077\376" },
    { ENC_END, 0, 0, NULL } 
};

static TEncodingRule TDOM_UnicodeToISO88591 [] = {
    { ENC_IDENTITY, 1, 255, "" }, 
    { ENC_END, 0, 0, NULL } 
};

static TEncodingRule TDOM_UnicodeToISO88592 [] = {
    { ENC_IDENTITY, 1, 160, "" }, 
    { ENC_MAP, 164, 120, 
        "\244\077\247\250\077\077\077\077\255\077\077\260\077\077"
        "\077\264\077\077\077\270\077\077\077\077\077\077\077\077"
        "\301\302\077\304\077\077\307\077\311\077\313\077\315\316"
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        "\346\077\077\077\077\310\350\317\357\320\360\077\077\077"
        "\077\077\077\312\352\314\354" },
    { ENC_MAP, 313, 70, 
        "\305\345\077\077\245\265\077\077\243\263\321\361\077\077"
        "\322\362\077\077\077\077\077\077\077\325\365\077\077\300"
        "\340\077\077\330\370\246\266\077\077\252\272\251\271\336"
        "\376\253\273\077\077\077\077\077\077\077\077\331\371\333"
        "\373\077\077\077\077\077\077\077\254\274\257\277\256\276"
    },
    { ENC_MAP, 711, 23, 
        "\267\077\077\077\077\077\077\077\077\077\077\077\077\077"
        "\077\077\077\242\377\077\262\077\275" },
    { ENC_END, 0, 0, NULL } 
};

static TEncodingRule TDOM_UnicodeToISO88593 [] = {
    { ENC_IDENTITY, 1, 160, "" }, 
    { ENC_MAP, 163, 147, 
        "\243\244\247\250\077\077\077\077\255\077\077\260\077\262"
        "\263\264\265\077\267\270\077\077\077\077\275\077\077\300"
        "\301\302\077\304\077\077\307\310\311\312\313\314\315\316"
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        "\077\246\266\241\261\077\077\077\077\077\077\077\077\251"
        "\271\077\077\254\274" },
    { ENC_MAP, 348, 33, 
        "\336\376\252\272\077\077\077\077\077\077\077\077\077\077"
        "\077\077\335\375\077\077\077\077\077\077\077\077\077\077"
        "\077\077\077\257\277" },
    { ENC_MAP, 728, 2, 
        "\242\377" },
    { ENC_END, 0, 0, NULL } 
};

static TEncodingRule TDOM_UnicodeToISO88594 [] = {
    { ENC_IDENTITY, 1, 160, "" }, 
    { ENC_MAP, 164, 219, 
        "\244\077\247\250\077\077\077\077\255\077\257\260\077\077"
        "\077\264\077\077\077\270\077\077\077\077\077\077\077\077"
        "\301\302\303\304\305\306\077\077\311\077\313\077\315\316"
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        "\375\336\376\077\077\077\077\077\077\331\371\077\077\077"
        "\077\077\077\077\077\077\256\276" },
    { ENC_MAP, 711, 21, 
        "\267\077\077\077\077\077\077\077\077\077\077\077\077\077"
        "\077\077\077\077\377\077\262" },
    { ENC_END, 0, 0, NULL } 
};

static TEncodingRule TDOM_UnicodeToISO88595 [] = {
    { ENC_IDENTITY, 1, 160, "" }, 
    { ENC_MAP, 167, 7, 
        "\375\077\077\077\077\077\255" },
    { ENC_MAP, 1025, 95, 
        "\241\242\243\244\245\246\247\250\251\252\253\254\077\256"
        "\257\260\261\262\263\264\265\266\267\270\271\272\273\274"
        "\275\276\277\300\301\302\303\304\305\306\307\310\311\312"
        "\313\314\315\316\317\320\321\322\323\324\325\326\327\330"
        "\331\332\333\334\335\336\337\340\341\342\343\344\345\346"
        "\347\350\351\352\353\354\355\356\357\077\361\362\363\364"
        "\365\366\367\370\371\372\373\374\077\376\377" },
    { ENC_MAP, 8470, 1, 
        "\360" },
    { ENC_END, 0, 0, NULL } 
};

static TEncodingRule TDOM_UnicodeToISO88596 [] = {
    { ENC_IDENTITY, 1, 47, "" }, 
    { ENC_IDENTITY, 58, 103, "" }, 
    { ENC_MAP, 164, 10, 
        "\244\077\077\077\077\077\077\077\255" },
    { ENC_MAP, 1548, 94, 
        "\254\077\077\077\077\077\077\077\077\077\077\077\077\077"
        "\077\273\077\077\077\277\077\301\302\303\304\305\306\307"
        "\310\311\312\313\314\315\316\317\320\321\322\323\324\325"
        "\326\327\330\331\332\077\077\077\077\077\340\341\342\343"
        "\344\345\346\347\350\351\352\353\354\355\356\357\360\361"
        "\362\077\077\077\077\077\077\077\077\077\077\077\077\077"
        "\060\061\062\063\064\065\066\067\070\071" },
    { ENC_END, 0, 0, NULL } 
};

static TEncodingRule TDOM_UnicodeToISO88597 [] = {
    { ENC_IDENTITY, 1, 160, "" }, 
    { ENC_MAP, 163, 27, 
        "\243\077\246\247\250\251\077\253\254\255\077\077\260\261"
        "\262\263\077\077\077\267\077\077\077\273\077\275" },
    { ENC_MAP, 700, 2, 
        "\242\241" },
    { ENC_MAP, 900, 75, 
        "\264\265\266\077\270\271\272\077\274\077\276\277\300\301"
        "\302\303\304\305\306\307\310\311\312\313\314\315\316\317"
        "\320\321\077\323\324\325\326\327\330\331\332\333\334\335"
        "\336\337\340\341\342\343\344\345\346\347\350\351\352\353"
        "\354\355\356\357\360\361\362\363\364\365\366\367\370\371"
        "\372\373\374\375\376" },
    { ENC_MAP, 8213, 1, 
        "\257" },
    { ENC_END, 0, 0, NULL } 
};

static TEncodingRule TDOM_UnicodeToISO88598 [] = {
    { ENC_IDENTITY, 1, 160, "" }, 
    { ENC_MAP, 162, 54, 
        "\242\243\244\245\246\247\250\251\253\254\255\256\260\261"
        "\262\263\264\265\266\267\270\271\273\274\275\276\077\077"
        "\077\077\077\077\077\077\077\077\077\077\077\077\077\077"
        "\077\077\077\252" },
    { ENC_MAP, 247, 1, 
        "\272" },
    { ENC_MAP, 1488, 27, 
        "\340\341\342\343\344\345\346\347\350\351\352\353\354\355"
        "\356\357\360\361\362\363\364\365\366\367\370\371\372" },
    { ENC_MAP, 8215, 1, 
        "\337" },
    { ENC_MAP, 8254, 1, 
        "\257" },
    { ENC_END, 0, 0, NULL } 
};

static TEncodingRule TDOM_UnicodeToISO88599 [] = {
    { ENC_IDENTITY, 1, 207, "" }, 
    { ENC_MAP, 209, 54, 
        "\321\322\323\324\325\326\327\330\331\332\333\334\337\340"
        "\341\342\343\344\345\346\347\350\351\352\353\354\355\356"
        "\357\361\362\363\364\365\366\367\370\371\372\373\374\377"
    },
    { ENC_MAP, 286, 20, 
        "\320\360\077\077\077\077\077\077\077\077\077\077\077\077"
        "\077\077\077\077\335\375" },
    { ENC_MAP, 350, 2, 
        "\336\376" },
    { ENC_END, 0, 0, NULL } 
};

static TEncodingRule TDOM_UnicodeToKOI8R [] = {
    { ENC_IDENTITY, 1, 127, "" }, 
    { ENC_MAP, 160, 24, 
        "\232\077\077\077\077\077\077\077\077\277\077\077\077\077"
        "\077\077\234\077\235\077\077\077\077\236" },
    { ENC_MAP, 247, 1, 
        "\237" },
    { ENC_MAP, 1025, 81, 
        "\263\077\077\077\077\077\077\077\077\077\077\077\077\077"
        "\077\341\342\367\347\344\345\366\372\351\352\353\354\355"
        "\356\357\360\362\363\364\365\346\350\343\376\373\375\377"
        "\371\370\374\340\361\301\302\327\307\304\305\326\332\311"
        "\312\313\314\315\316\317\320\322\323\324\325\306\310\303"
        "\336\333\335\337\331\330\334\300\321\077\243" },
    { ENC_MAP, 8729, 2, 
        "\225\226" },
    { ENC_MAP, 8776, 1, 
        "\227" },
    { ENC_MAP, 8804, 2, 
        "\230\231" },
    { ENC_MAP, 8992, 2, 
        "\223\233" },
    { ENC_MAP, 9472, 161, 
        "\200\077\201\077\077\077\077\077\077\077\077\077\202\077"
        "\077\077\203\077\077\077\204\077\077\077\205\077\077\077"
        "\206\077\077\077\077\077\077\077\207\077\077\077\077\077"
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        "\216\077\077\077\217\220\221\222\077\077\077\077\077\077"
        "\077\077\077\077\077\077\224" },
    { ENC_END, 0, 0, NULL } 
};


static TEncoding TDOM_UnicodeTo8bitEncodings [] = {
    { "ascii"     , 0x3F, TDOM_UnicodeToASCII },
    { "cp1250"    , 0x3F, TDOM_UnicodeToCP1250 },
    { "cp1251"    , 0x3F, TDOM_UnicodeToCP1251 },
    { "cp1252"    , 0x3F, TDOM_UnicodeToCP1252 },
    { "cp1253"    , 0x3F, TDOM_UnicodeToCP1253 },
    { "cp1254"    , 0x3F, TDOM_UnicodeToCP1254 },
    { "cp1255"    , 0x3F, TDOM_UnicodeToCP1255 },
    { "cp1256"    , 0x3F, TDOM_UnicodeToCP1256 },
    { "cp437"     , 0x3F, TDOM_UnicodeToCP437 },
    { "cp850"     , 0x3F, TDOM_UnicodeToCP850 },
    { "iso8859-1" , 0x3F, TDOM_UnicodeToISO88591 },
    { "iso8859-2" , 0x3F, TDOM_UnicodeToISO88592 },
    { "iso8859-3" , 0x3F, TDOM_UnicodeToISO88593 },
    { "iso8859-4" , 0x3F, TDOM_UnicodeToISO88594 },
    { "iso8859-5" , 0x3F, TDOM_UnicodeToISO88595 },
    { "iso8859-6" , 0x3F, TDOM_UnicodeToISO88596 },
    { "iso8859-7" , 0x3F, TDOM_UnicodeToISO88597 },
    { "iso8859-8" , 0x3F, TDOM_UnicodeToISO88598 },
    { "iso8859-9" , 0x3F, TDOM_UnicodeToISO88599 },
    { "koi8-r"    , 0x3F, TDOM_UnicodeToKOI8R },
    { NULL, 0, NULL }
};
