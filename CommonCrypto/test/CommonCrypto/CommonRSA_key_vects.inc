{
.sm  =  "e2dc07e14253b5f56e078d9921d08fe25848b8b41f945f2b73ad6c3c4d9ce21b6432ec65fbbe895c7780d11a555e38f6e7fc4a0f07c0d57625576a47a5121e184aef0f52e9a8e2f38442cb98fea035c66a4c5fde9ee376d395b18a025e84ff8a14ed2340fbf38e615b1a50415d8fdd63498858c322a04937f46b5b3a30332d675a6a04d02cbab115ffb94172bb629cd809f0d3b3dd2edf8261c63968b42fbd9f5f3881d9bcfd4873d5dd42e6bf4afddbf76cb11f66592b5cd548740f7d5dde48c57a83037c4adaef54bfb83234978c48fd5bb8a21520b00db751913ed8160a6132c00f502a290728d44c43daa181054e41423ee508495a5bdbb3e85f518aad45cbb30769c7a189ac2f60a06b6be4ec14be7512828134d8657b359218e1c3e89eb7dc9e6d3aa8d556717e06824461a18070cbfe454cc06f83cfdff1412a18c1c5",
.se  =  "010001",
.sp1  = "fae7bd42f70a7439884ab450b84e94f8c76990eab24b53b9807e5a53779a9c02b4ac5c97b467779de13c80034920db510b433bceabc8dfb189628d5d0310494e62541d1ab3aefbcce88622af1d1a649226af6096fc44480e208534e3b2d7fbcd863e4bdb1aa919fb5993fd67a6d3482311e8bfa20aa9163268824184b8c00db04d57397d24f1de528a74556774f6f7be0d3de37b3922dcfd6d5ad18da3fe5c41",
.sp2 = "e7774be37dda30af8c38ddb04457297667af63db7ff17cf67572bd77682ce3c12dabebe90c13a6be3bfe1eadc11038b83cf03987a6f0bef143270db3a61388710d3d12252d69f296097723fa3f9eba25196d116519019883ff9a77aea6e985e162cd4ebefde14e87286c59d66d086703a5f3d76fa245d9b42269b9d4cb9ebc9e6f1c7c266d0ef4d7ed09a3c402b7d279834fc3dd90da63c1b1776d11d34dd485",
},

{
.sm  =  "ac49cdef10fe6f5b094a01612078002907d5e99269a5b920ef8890128907e5fc2cd589d564bd1f8c94a91290c311eeedb9e2ef9b2f1cb5bc8365f93b0052fabb1ec65ef0dbc0286b4cefdcee881e3ebb009a28102b30d63dd0c7f871db4b073f388820e76a20a2d0e55d7dc654d45707ec91900ac7668e146ae49d4786f46592f76ec727829cfe77cea9884ee4199ff22cfe6cad0f92e82ded8c372632b5d0db8e8856cdb4cbe77a5dc8c8cbd395abae25c2b1e8635950b3449509729c1155c75d5425e653872e31f697a447e271b5ff86efada48651dfb18dd32ca0959cf7250066f4f2ef6d201f378023feb501b5c366ea0ebccc95b27cc95734b61cb53af7e8a325fc93cba701fe1ef5caf83fb83097a355162cf3b00a3f13c0fb4716986c3ea002e63e2699308475bab68ac72c54a41e6522c6160892024eb7a91541e9bc549b28b665d37bc6b4570e93ba87710a65655e180fe2517a7bef32538e695332bfcd4fd00eea95a8cd5268cf08129617d64a6c7bba50dcbb2fbdda5143efd2effef93bcdbe617cdca658d9e48d0301f86ad6ab89fc0c86e18d5701b96f419b041f7e26e95e145ac8daf90b1c9daa86581824e56f2fbf589bd8a3844d34705463b27774801b338c83566b0f3205161cd1582a6ee34ac6d89eb46c419753a19e2b4b74cbabae425c4aa849f981704235a484891fbf49dcf86188e7f1548c837597",
.se  = "010001",
.sp1  = "d2603b41e3a9cffa1f909ec920bb04e8b082a3735ee559ff8cb547b6f31de242f4b58d3b06cb2a856b1a6b839604ea4ff8bad2752a80d313e1cc557452d5a35d0c6257601ffffceefb6d242c788ef3fada8995d10731ce6057f70d0270b4d8e701505ca191acb0d2783d00e66ccaf04115bf0d407524a1829a349999a14887f1c933876ed28d203681a128cc2eb3e317b3aac1a9976c42dbcf655b0d0f461c33415a7048d29b955aca5a746c78e22887167e0b75efa5cfc3c944a57da4337682996d1d35609674add22dcdea769136bf5885a685e91dec473fb6ceb87802e6993e03ba6095ad91ab53e57c0f0cb91660d8066bf10575a12b406df53e877e73f5",
.sp2  = "d1a700f2e8a3217ead777f87dd6a7a872c96b5db646e258d7651fba79d326785eb23c1553f05a4ae06fc7ea2a50af3ddd1136ebb8d5eff8423704d75733bf91c28b55243dc66b75e125f5acbe1437d0ddba988494cbceb0b6683b0708f72c5e728b65295ba33d8197af420493bcaa61673841a3eb1cfafb62806becdeb55c56ba4717439e97341d21ac1e9944134e23f7d3204926b7def11b317573f616979141632807574ab54ad13c98a273ae72b655f74e263919f2eec456d69b3020adeec68044572fb3f538f1c5688c4986f93b16fd989946581cdf4a742aae36f8f9574c9b728dc1a4bea29f9b099a69248e61614319c0a8734a72cf1df6f90fb7657db",
},
{.sm=NULL}
