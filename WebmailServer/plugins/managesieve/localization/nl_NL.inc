<?php

$labels = array();
$labels['filters'] = 'Filters';
$labels['managefilters'] = 'Beheer inkomende mail filters';
$labels['filtername'] = 'Filternaam';
$labels['newfilter'] = 'Nieuw filter';
$labels['filteradd'] = 'Filter toevoegen';
$labels['filterdel'] = 'Filter verwijderen';
$labels['moveup'] = 'Omhoog';
$labels['movedown'] = 'Omlaag';
$labels['filterallof'] = 'die voldoen aan alle volgende regels';
$labels['filteranyof'] = 'die voldoen aan een van de volgende regels';
$labels['filterany'] = 'alle berichten';
$labels['filtercontains'] = 'bevat';
$labels['filternotcontains'] = 'bevat niet';
$labels['filteris'] = 'is gelijk aan';
$labels['filterisnot'] = 'is niet gelijk aan';
$labels['filterexists'] = 'bestaat';
$labels['filternotexists'] = 'bestaat niet';
$labels['filterunder'] = 'onder';
$labels['filterover'] = 'over';
$labels['addrule'] = 'Regel toevoegen';
$labels['delrule'] = 'Regel verwijderen';
$labels['messagemoveto'] = 'Verplaats bericht naar';
$labels['messageredirect'] = 'Redirect bericht naar';
$labels['messagecopyto'] = 'Kopieer bericht naar';
$labels['messagesendcopy'] = 'Stuur berichtkopie naar';
$labels['messagereply'] = 'Beantwoord met bericht';
$labels['messagedelete'] = 'Verwijder bericht';
$labels['messagediscard'] = 'Wijs af met bericht';
$labels['messagesrules'] = 'Voor binnenkomende e-mail';
$labels['messagesactions'] = '...voer de volgende acties uit';
$labels['add'] = 'Toevoegen';
$labels['del'] = 'Verwijderen';
$labels['sender'] = 'Afzender';
$labels['recipient'] = 'Ontvanger';
$labels['vacationaddresses'] = 'Aanvullende lijst met ontvangeradressen (door komma\'s gescheiden):';
$labels['vacationdays'] = 'Frequentie voor versturen berichten (in dagen):';
$labels['vacationreason'] = 'Berichttekst (reden afwezigheid):';
$labels['rulestop'] = 'Stop met evalueren van regels';
$labels['filterset'] = 'Filterset';
$labels['filtersetadd'] = 'Voeg filterset toe';
$labels['filtersetdel'] = 'Verwijder huidige filterset';
$labels['filtersetact'] = 'Activeer huidige filterset';
$labels['filtersetdeact'] = 'Deactiveer huidige filterset';
$labels['filtersetget'] = 'Download filterset in tekststructuur';
$labels['filterdef'] = 'Filterdefinitie';
$labels['filtersetname'] = 'Naam filterset';
$labels['newfilterset'] = 'Nieuwe filterset';
$labels['active'] = 'actief';
$labels['none'] = 'geen';
$labels['fromset'] = 'uit set';
$labels['fromfile'] = 'uit bestand';
$labels['filterdisabled'] = 'Filter uitgeschakeld';
$labels['countisgreaterthan'] = 'aantal is groter dan';
$labels['countisgreaterthanequal'] = 'aantal is groter dan of gelijk aan';
$labels['countislessthan'] = 'aantal is kleiner dan';
$labels['countislessthanequal'] = 'aantal is kleiner dan of gelijk aan';
$labels['countequals'] = 'aantal is gelijk aan';
$labels['countnotequals'] = 'aantal is niet gelijk aan';
$labels['valueisgreaterthan'] = 'waarde is groter dan';
$labels['valueisgreaterthanequal'] = 'waarde is groter dan of gelijk aan';
$labels['valueislessthan'] = 'waarde is kleiner dan';
$labels['valueislessthanequal'] = 'waarde is kleiner dan of gelijk aan';
$labels['valueequals'] = 'waarde is gelijk aan';
$labels['valuenotequals'] = 'waarde is niet gelijk aan';

$messages = array();
$messages['filterunknownerror'] = 'Onbekende fout';
$messages['filterconnerror'] = 'Kan geen verbinding maken met de managesieve server';
$messages['filterdeleteerror'] = 'Kan filter niet verwijderen. Er is een fout opgetreden';
$messages['filterdeleted'] = 'Filter succesvol verwijderd';
$messages['filterdeleteconfirm'] = 'Weet je zeker dat je het geselecteerde filter wilt verwijderen?';
$messages['filtersaved'] = 'Filter succesvol opgeslagen';
$messages['filtersaveerror'] = 'Kan filter niet opslaan. Er is een fout opgetreden.';
$messages['ruledeleteconfirm'] = 'Weet je zeker dat je de geselecteerde regel wilt verwijderen?';
$messages['actiondeleteconfirm'] = 'Weet je zeker dat je de geselecteerde actie wilt verwijderen?';
$messages['forbiddenchars'] = 'Verboden karakters in het veld';
$messages['cannotbeempty'] = 'Veld mag niet leeg zijn';
$messages['setactivateerror'] = 'Kan geselecteerde filterset niet activeren. Er is een fout opgetreden.';
$messages['setdeactivateerror'] = 'Kan geselecteerde filterset niet deactiveren. Er is een fout opgetreden.';
$messages['setdeleteerror'] = 'Kan geselecteerde filterset niet verwijderen. Er is een fout opgetreden.';
$messages['setactivated'] = 'Filterset is geactiveerd';
$messages['setdeactivated'] = 'Filterset is gedeactiveerd';
$messages['setdeleted'] = 'Filterset is verwijderd';
$messages['setdeleteconfirm'] = 'Weet je zeker dat je de geselecteerde filterset wilt verwijderen?';
$messages['setcreateerror'] = 'Kan filterset niet aanmaken. Er is een fout opgetreden.';
$messages['setcreated'] = 'Filterset is aangemaakt';
$messages['emptyname'] = 'Kan filterset niet aanmaken. Setnaam is leeg.';
$messages['nametoolong'] = 'Kan filterset niet aanmaken. Naam is te lang.'

?>
