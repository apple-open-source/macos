<?php

$labels = array();
$labels['filters'] = '过滤器';
$labels['managefilters'] = '管理邮件过滤器';
$labels['filtername'] = '过滤器名称';
$labels['newfilter'] = '新建过滤器';
$labels['filteradd'] = '添加过滤器';
$labels['filterdel'] = '删除过滤器';
$labels['moveup'] = '上移';
$labels['movedown'] = '下移';
$labels['filterallof'] = '匹配所有规则';
$labels['filteranyof'] = '匹配任意一条规则';
$labels['filterany'] = '所有邮件';
$labels['filtercontains'] = '包含';
$labels['filternotcontains'] = '不包含';
$labels['filteris'] = '等于';
$labels['filterisnot'] = '不等于';
$labels['filterexists'] = '存在';
$labels['filternotexists'] = '不存在';
$labels['filterunder'] = '小于';
$labels['filterover'] = '大于';
$labels['addrule'] = '添加规则';
$labels['delrule'] = '删除规则';
$labels['messagemoveto'] = '将邮件移动到';
$labels['messageredirect'] = '将邮件转发到';
$labels['messagecopyto'] = '将邮件拷贝到';
$labels['messagesendcopy'] = '将邮件副本发送到';
$labels['messagereply'] = '以下列内容回复';
$labels['messagedelete'] = '删除邮件';
$labels['messagediscard'] = '丢弃邮件并以下列内容回复';
$labels['messagesrules'] = '对收取的邮件应用规则：';
$labels['messagesactions'] = '...执行以下动作：';
$labels['add'] = '添加';
$labels['del'] = '删除';
$labels['sender'] = '发件人';
$labels['recipient'] = '收件人';
$labels['vacationaddresses'] = '其他收件人的电子邮件地址（用半角逗号隔开）：';
$labels['vacationdays'] = '邮件发送频率（以天为单位）：';
$labels['vacationreason'] = '邮件正文（度假原因）：';
$labels['rulestop'] = '停止评估规则';
$labels['filterset'] = '过滤器集合';
$labels['filtersetadd'] = '添加过滤器集合';
$labels['filtersetdel'] = '删除目前的过滤器集合';
$labels['filtersetact'] = '激活目前的过滤器集合';
$labels['filtersetdeact'] = '停用目前的过滤器集合';
$labels['filtersetget'] = '以文本格式下载过滤器集合';
$labels['filterdef'] = '过滤器定义';
$labels['filtersetname'] = '过滤器集合的名称';
$labels['newfilterset'] = '新建过滤器集合';
$labels['active'] = '活跃';
$labels['none'] = '无';
$labels['fromset'] = '从集合';
$labels['fromfile'] = '从文件';
$labels['filterdisabled'] = '已停用过滤器';
$labels['countisgreaterthan'] = '数目大于';
$labels['countisgreaterthanequal'] = '数目大于或等于';
$labels['countislessthan'] = '数目小于';
$labels['countislessthanequal'] = '数目小于或等于';
$labels['countequals'] = '数目等于';
$labels['countnotequals'] = '数目不等于';
$labels['valueisgreaterthan'] = '值大于';
$labels['valueisgreaterthanequal'] = '值大于或等于';
$labels['valueislessthan'] = '值小于';
$labels['valueislessthanequal'] = '值小于或等于';
$labels['valueequals'] = '值等于';
$labels['valuenotequals'] = '值不等于';

$messages = array();
$messages['filterunknownerror'] = '未知的服务器错误';
$messages['filterconnerror'] = '无法连接到 managesieve 服务器';
$messages['filterdeleteerror'] = '无法删除过滤器。服务器错误';
$messages['filterdeleted'] = '过滤器已成功删除';
$messages['filterdeleteconfirm'] = '您确定要删除所选择的过滤器吗？';
$messages['filtersaved'] = '过滤器已成功保存。';
$messages['filtersaveerror'] = '无法保存过滤器。服务器错误';
$messages['ruledeleteconfirm'] = '您确定要删除所选择的规则吗？';
$messages['actiondeleteconfirm'] = '您确定要删除所选择的动作吗？';
$messages['forbiddenchars'] = '内容中包含禁用的字符';
$messages['cannotbeempty'] = '内容不能为空';
$messages['setactivateerror'] = '无法激活所选过滤器集合。发生服务器故障';
$messages['setdeactivateerror'] = '无法停用所选过滤器集合。发生服务器故障';
$messages['setdeleteerror'] = '无法删除所选过滤器集合。发生服务器故障';
$messages['setactivated'] = '已成功激活过滤器集合';
$messages['setdeactivated'] = '已成功停用过滤器集合';
$messages['setdeleted'] = '已成功删除过滤器集合';
$messages['setdeleteconfirm'] = '您确定要删除所选过滤器集合吗？';
$messages['setcreateerror'] = '无法创建过滤器集合。发生服务器故障';
$messages['setcreated'] = '已成功创建过滤器集合';
$messages['emptyname'] = '无法创建过滤器集合。集合名称为空';
$messages['nametoolong'] = '无法创建过滤器集合。名称太长'

?>
