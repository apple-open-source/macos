<?php

$labels = array();
$labels['filters'] = 'Filtres';
$labels['managefilters'] = 'Gestion des filtres sur les mails entrants';
$labels['filtername'] = 'Nom du filtre';
$labels['newfilter'] = 'Nouveau filtre';
$labels['filteradd'] = 'Ajouter un filtre';
$labels['filterdel'] = 'Supprimer un filtre';
$labels['moveup'] = 'Monter';
$labels['movedown'] = 'Descendre';
$labels['filterallof'] = 'valident toutes les conditions suivantes';
$labels['filteranyof'] = 'valident au moins une des conditions suivantes';
$labels['filterany'] = 'tous les messages';
$labels['filtercontains'] = 'contient';
$labels['filternotcontains'] = 'ne contient pas';
$labels['filteris'] = 'est ';
$labels['filterisnot'] = 'n\'est pas';
$labels['filterexists'] = 'existe';
$labels['filternotexists'] = 'n\'existe pas';
$labels['filterunder'] = 'est plus petit que';
$labels['filterover'] = 'est plus grand que';
$labels['addrule'] = 'Ajouter une règle';
$labels['delrule'] = 'Supprimer une règle';
$labels['messagemoveto'] = 'Déplacer le message vers';
$labels['messageredirect'] = 'Transférer le message à';
$labels['messagecopyto'] = 'Copier le message vers';
$labels['messagesendcopy'] = 'Envoyer une copie du message à';
$labels['messagereply'] = 'Répondre avec le message';
$labels['messagedelete'] = 'Supprimer le message';
$labels['messagediscard'] = 'Rejeter avec le message';
$labels['messagesrules'] = 'Pour les messages entrants :';
$labels['messagesactions'] = '...exécuter les actions suivantes :';
$labels['add'] = 'Ajouter';
$labels['del'] = 'Supprimer';
$labels['sender'] = 'Expéditeur';
$labels['recipient'] = 'Destinataire';
$labels['vacationaddresses'] = 'Liste des destinataires (séparés par des virgules) :';
$labels['vacationdays'] = 'Ne pas renvoyer un message avant (jours) :';
$labels['vacationreason'] = 'Corps du message (raison de l\'absence) :';
$labels['rulestop'] = 'Arrêter d\'évaluer les règles suivantes';
$labels['filterset'] = 'Jeu de filtres';
$labels['filtersetadd'] = 'Ajouter un jeu de filtres';
$labels['filtersetdel'] = 'Supprimer le jeu de filtres actuel';
$labels['filtersetact'] = 'Activer le jeu de filtres actuel';
$labels['filtersetdeact'] = 'Désactiver le jeu de filtres actuel';
$labels['filtersetget'] = 'Télécharger le jeu de filtres en format texte';
$labels['filterdef'] = 'Définition du filtre';
$labels['filtersetname'] = 'Nom du jeu de filtres';
$labels['newfilterset'] = 'Nouveau jeu de filtres';
$labels['active'] = 'actif';
$labels['none'] = 'aucun';
$labels['fromset'] = 'à partir du jeu';
$labels['fromfile'] = 'à partir du filtre';
$labels['filterdisabled'] = 'Filtre désactivé';
$labels['countisgreaterthan'] = 'nombre supérieur à';
$labels['countisgreaterthanequal'] = 'nombre supérieur ou égal à';
$labels['countislessthan'] = 'nombre inférieur à';
$labels['countislessthanequal'] = 'nombre inférieur ou égal à';
$labels['countequals'] = 'nombre égal à';
$labels['countnotequals'] = 'nombre différent de';
$labels['valueisgreaterthan'] = 'valeur supérieure à';
$labels['valueisgreaterthanequal'] = 'valeur supérieure ou égale à';
$labels['valueislessthan'] = 'valeur inférieure à';
$labels['valueislessthanequal'] = 'valeur inférieure ou égale à';
$labels['valueequals'] = 'valeur égale à';
$labels['valuenotequals'] = 'valeur différente de';

$messages = array();
$messages['filterunknownerror'] = 'Erreur du serveur inconnue';
$messages['filterconnerror'] = 'Connexion au serveur Managesieve impossible';
$messages['filterdeleteerror'] = 'Suppression du filtre impossible. Le serveur a produit une erreur';
$messages['filterdeleted'] = 'Le filtre a bien été supprimé';
$messages['filterdeleteconfirm'] = 'Voulez-vous vraiment supprimer le filtre sélectionné ?';
$messages['filtersaved'] = 'Le filtre a bien été enregistré';
$messages['filtersaveerror'] = 'Enregistrement du filtre impossible. Le serveur a produit une erreur';
$messages['ruledeleteconfirm'] = 'Voulez-vous vraiment supprimer la règle sélectionnée ?';
$messages['actiondeleteconfirm'] = 'Voulez-vous vraiment supprimer l\'action sélectionnée ?';
$messages['forbiddenchars'] = 'Caractères interdits dans le champ';
$messages['cannotbeempty'] = 'Le champ ne peut pas être vide';
$messages['setactivateerror'] = 'Impossible d\'activer le jeu de filtres sélectionné. Le serveur a produit une erreur';
$messages['setdeactivateerror'] = 'Impossible de désactiver le jeu de filtres sélectionné. Le serveur a produit une erreur';
$messages['setdeleteerror'] = 'Impossible de supprimer le jeu de filtres sélectionné. Le serveur a produit une erreur';
$messages['setactivated'] = 'Jeu de filtres activé';
$messages['setdeactivated'] = 'Jeu de filtres désactivé';
$messages['setdeleted'] = 'Jeu de filtres supprimé';
$messages['setdeleteconfirm'] = 'Souhaitez-vous vraiment supprimer le jeu de filtres sélectionné ?';
$messages['setcreateerror'] = 'Impossible de créer le jeu de filtres. Le serveur a produit une erreur';
$messages['setcreated'] = 'Jeu de filtres créé';
$messages['emptyname'] = 'Impossible de créer le jeu de filtres. Le nom est vide';
$messages['nametoolong'] = 'Impossible de créer le jeu de filtres. Le nom est trop long'

?>
